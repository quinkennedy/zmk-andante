## config/west.yml
```yaml
manifest:
  remotes:
    - name: jmding
      url-base: https://github.com/jmding8
  projects:
    - name: zmk
      remote: jmding
      revision: personal
      import: app/west.yml
  self:
    path: config
```
